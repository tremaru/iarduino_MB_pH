// ПРИМЕР ПОЛУЧЕНИЯ НАСТРОЕК, ПОТЕНЦИАЛОВ, КИСЛОТНОСТИ И ОШИБОК:                   //
                                                                                   //
#include <SoftwareSerial.h>                                                        //   Подключаем библиотеку для работы с программной шиной UART.
#include <iarduino_Modbus.h>                                                       //   Подключаем библиотеку для работы по протоколу Modbus.
#include <iarduino_MB_pH.h>                                                        //   Подключаем библиотеку для работы с pH-метрами.
                                                                                   //
SoftwareSerial rs485(8,9);                                                         //   Создаём объект для работы с программной шиной UART-RS485 указывая выводы RX, TX.
ModbusClient   modbus(rs485, 2);                                                   //   Создаём объект для работы по протоколу Modbus указывая объект программной шины UART-RS485 и вывод DE конвертера UART-RS485.
iarduino_MB_pH sensor(modbus);                                                     //   Создаём объект для работы с pH-метром указывая объект протокола Modbus.
                                                                                   //
void setup(){                                                                      //
     Serial.begin(9600); while(!Serial);                                           //   Инициируем передачу данных в монитор последовательного порта, указав его скорость.
     rs485.begin(9600); while(!rs485);                                             //   Инициируем работу с программной шиной UART-RS485 указав её скорость.
     modbus.begin();                                                               //   Инициируем работу по протоколу Modbus.
//   modbus.setTimeout(10);                                                        //   Указываем максимальное время ожидания ответа по протоколу Modbus.
//   modbus.setDelay(4);                                                           //   Указываем минимальный интервал между отправляемыми сообщениями по протоколу Modbus.
//   modbus.setTypeMB( MODBUS_RTU );                                               //   Указываем тип протокола Modbus: MODBUS_RTU (по умолчанию), или MODBUS_ASCII.
     sensor.begin(4);                                                              //   Инициируем работу с pH-метром, указав его адрес.
}                                                                                  //   Если адрес не указан sensor.begin(), то он будет найден, но это займёт некоторое время.
                                                                                   //
void loop(){                                                                       //
     delay(1000);                                                                  //
//   Получаем данные от модуля:                                                    //
     float   Vstp = sensor.getVstp();                                              //   Получаем чувствительность щупа            (0,01...655,35 мВ/pH).
     float   pHn  = sensor.getPHn();                                               //   Получаем нейтральную кислотность для щупа (0...14,000 pH) при которой на выводах щупа нет разности потенциалов.
     float   Vin  = sensor.getVin();                                               //   Получаем потенциал на входе щупа          (0,5*3,3 ± 0,1 В).
     float   Vout = sensor.getVout();                                              //   Получаем потенциал на выходе щупа         (0,0...3,3 В).
     float   pH   = sensor.getPH();                                                //   Получаем кислотность жидкости             (0...14,000 pH).
     int32_t err  = sensor.getErr();                                               //   Получаем ошибки диагностики               (модуль постоянно проводит самодиагностику).
     int8_t  stab = sensor.getStability();                                         //   Получаем флаг нормализации показаний      (true/false) указывает что pH не меняется.
//   Проверяем наличие данных:                                                     //
     if( (Vstp<0)&&(pHn<0)&&(Vin<0)&&(Vout<0)&&(pH<0)&&(err<0)&&(stab<0) ){        //   Если все параметры не получены, значит модуль отсутствует на шине.
         Serial.println(F("Нет ответа от модуля")); return;                        //
     }                                                                             //
     if( (Vstp<0)||(pHn<0)||(Vin<0)||(Vout<0)||(pH<0)||(err<0)||(stab<0) ){        //   Если любой из параметров не получен, значит верить полученным данным нельзя.
         Serial.println(F("Модуль отвечает с перебоями")); return;                 //
     }                                                                             //
//   Выводим параметры щупа:                                                       //
     Serial.print(F("Параметры щупа: "));                                          //
     Serial.print(F("Vstp=")); Serial.print(Vstp,2); Serial.print(F("мВ/pH, "));   //   Выводим чувствительность датчика.
     Serial.print(F("pHn=" )); Serial.print(pHn ,3); Serial.print(F("pH, "   ));   //   Выводим нейтральную кислотность для датчика.
//   Потенциалы щупа:                                                              //
     Serial.print(F("Потенциалы щупа: "));                                         //
     Serial.print(F("Vin=" )); Serial.print(Vin ,4); Serial.print(F("В, "));       //   Выводим потенциал поданный на вход датчика.
     Serial.print(F("Vout=")); Serial.print(Vout,4); Serial.print(F("В. "));       //   Выводим потенциал получаемый с выхода датчика.
//   Выводим стадию калибровки:                                                    //
     int8_t calib=sensor.getCalibration();                                         //
     Serial.print(F("Калибровка "));                                               //
     if( calib==0 ){ Serial.print(F("не выполняется. "          )); }              //
     if( calib==1 ){ Serial.print(F("на 1 стадии. "             )); }              //
     if( calib==2 ){ Serial.print(F("на 2 стадии. "             )); }              //
     if( calib==3 ){ Serial.print(F("на стадии смены жидкости. ")); }              //
//   Информируем о наличии ошибок:                                                 //
     if( err                 ){ Serial.print(F("Показания не точны! "         ));} //   Если есть ошибки.
     if( err&ERR_MB_pH_Power ){ Serial.print(F("Выполняется стабилизация. "   ));} //   Прибору требуется время для стабилизации показаний после подачи питания.
     if( err&ERR_MB_pH_Data  ){ Serial.print(F("Ошибка чтения данных из АЦП. "));} //   Чип АЦП на плате блока не отвечает.
     if( err&ERR_MB_pH_Jumps ){ Serial.print(F("Значение pH 'скачет'. "       ));} //   Возможно плохой контакт на разъёме щупа или прибор не откалиброван.
     if( err&ERR_MB_pH_Vin   ){ Serial.print(F("Сбой напряжения входа щупа. " ));} //   Напряжение подаваемое на датчик вышло за допустимый диапазон.
     if( err&ERR_MB_pH_Vout  ){ Serial.print(F("Сбой напряжения выхода щупа. "));} //   Напряжение снимаемое с датчика вышло за допустимый диапазон.
     if( err&ERR_MB_pH_5V    ){ Serial.print(F("Низкое напряжение шины 5В. "  ));} //   Стабилизированное напряжение питания 5В < 4В. Стабильная работа не гарантируется.
     if( err&ERR_MB_pH_Init  ){ Serial.print(F("Ошибка инициализации АЦП. "   ));} //   Настройка АЦП на плате блока не выполнена.
//   Выводим кислотность:                                                          //
     Serial.print(F("Кислотность "));                                              //
     Serial.print( pH,2 ); Serial.print(F("pH"));                                  //   Выводим полученный водородный показатель жидкости.
     Serial.println( stab? ", стабильна.":" и меняется." );                        //   Информируем о стабильности показаний (меняется или нет).
}                                                                                  //