// ПРИМЕР ПОЛУЧЕНИЯ КИСЛОТНОСТИ С ПРОВЕРКОЙ НА НАЛИЧИЕ ОШИБОК ДИАГНОСТИКИ:         //
                                                                                   //
#include <SoftwareSerial.h>                                                        //   Подключаем библиотеку для работы с программной шиной UART.
#include <iarduino_Modbus.h>                                                       //   Подключаем библиотеку для работы по протоколу Modbus.
#include <iarduino_MB_pH.h>                                                        //   Подключаем библиотеку для работы с pH-метрами.
                                                                                   //
SoftwareSerial rs485(8,9);                                                         //   Создаём объект для работы с программной шиной UART-RS485 указывая выводы RX, TX.
ModbusClient   modbus(rs485, 2);                                                   //   Создаём объект для работы по протоколу Modbus указывая объект программной шины UART-RS485 и вывод DE конвертера UART-RS485.
iarduino_MB_pH sensor(modbus);                                                     //   Создаём объект для работы с pH-метром указывая объект протокола Modbus.
                                                                                   //
void setup(){                                                                      //
     Serial.begin(9600);   while(!Serial);                                         //   Инициируем передачу данных в монитор последовательного порта, указав его скорость.
     rs485.begin(9600); // while(!rs485 );                                         //   Инициируем работу с программной шиной UART-RS485 указав её скорость.
     modbus.begin();                                                               //   Инициируем работу по протоколу Modbus.
//   modbus.setTimeout(10);                                                        //   Указываем максимальное время ожидания ответа по протоколу Modbus.
//   modbus.setDelay(4);                                                           //   Указываем минимальный интервал между отправляемыми сообщениями по протоколу Modbus.
//   modbus.setTypeMB( MODBUS_RTU );                                               //   Указываем тип протокола Modbus: MODBUS_RTU (по умолчанию), или MODBUS_ASCII.
     sensor.begin(4);                                                              //   Инициируем работу с pH-метром, указав его адрес.
}                                                                                  //   Если адрес не указан sensor.begin(), то он будет найден, но это займёт некоторое время.
                                                                                   //
void loop(){                                                                       //
     delay(1000);                                                                  //
//   Получаем данные от модуля:                                                    //
     float   pH   = sensor.getPH();                                                //   Получаем кислотность жидкости.
     int32_t err  = sensor.getErr();                                               //   Получаем ошибки диагностики (модуль постоянно проводит самодиагностику).
     int8_t  stab = sensor.getStability();                                         //   Получаем флаг нормализации показаний кислотности (указывает что pH не меняется).
//   Информируем о отсутствии ответа:                                              //
     if( pH<0   ){ Serial.println( F("Нет ответа от pH-метра.") ); return; }       //   Сообщаем о ошибке чтения.
     if( err<0  ){ Serial.println( F("Нет ответа от pH-метра.") ); return; }       //   Сообщаем о ошибке чтения.
     if( stab<0 ){ Serial.println( F("Нет ответа от pH-метра.") ); return; }       //   Сообщаем о ошибке чтения.
//   Информируем о наличии ошибок:                                                 //
     if( err                   ){ Serial.print( F("Показания не точны! "                ) ); } //   Если есть ошибки.
     if( err & ERR_MB_pH_Power ){ Serial.print( F("Стабилизация после подачи питания. " ) ); } //   Прибору требуется время для стабилизации показаний после подачи питания.
     if( err & ERR_MB_pH_Data  ){ Serial.print( F("Ошибка чтения данных из АЦП. "       ) ); } //   Чип АЦП на плате блока не отвечает.
     if( err & ERR_MB_pH_Jumps ){ Serial.print( F("Значение pH 'скачет'. "              ) ); } //   Возможно плохой контакт на разъёме щупа или прибор не откалиброван.
     if( err & ERR_MB_pH_Vin   ){ Serial.print( F("Некорректное напряжение на датчике. ") ); } //   Напряжение подаваемое на датчик вышло за допустимый диапазон.
     if( err & ERR_MB_pH_Vout  ){ Serial.print( F("Некорректное напряжение от датчика. ") ); } //   Напряжение снимаемое с датчика вышло за допустимый диапазон.
     if( err & ERR_MB_pH_5V    ){ Serial.print( F("Низкое напряжение питания 5В. "      ) ); } //   Стабилизированное напряжение питания 5В < 4В. Стабильная работа не гарантируется.
     if( err & ERR_MB_pH_Init  ){ Serial.print( F("Ошибка инициализации АЦП. "          ) ); } //   Настройка АЦП на плате блока не выполнена.
//   Выводим результат:                                                            //
     Serial.print((String) "Кислотность "+pH+" pH");                               //   Выводим полученный водородный показатель жидкости.
     if( stab ){ Serial.println( F(", стабильна.") ); }                            //   Информируем о стабильности показаний (pH не меняется).
     else      { Serial.println( F(" и меняется.") ); }                            //   Информируем о не стабильности показаний (pH меняется).
}                                                                                  //