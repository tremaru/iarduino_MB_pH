// ПРИМЕР СБРОСА ВСЕХ НАСТРОЕК В ЗАВОДСКИЕ:                                        //
                                                                                   //
#include <SoftwareSerial.h>                                                        //   Подключаем библиотеку для работы с программной шиной UART.
#include <iarduino_Modbus.h>                                                       //   Подключаем библиотеку для работы по протоколу Modbus.
#include <iarduino_MB_pH.h>                                                        //   Подключаем библиотеку для работы с pH-метрами.
                                                                                   //
SoftwareSerial rs485(8,9);                                                         //   Создаём объект для работы с программной шиной UART-RS485 указывая выводы RX, TX.
ModbusClient   modbus(rs485, 2);                                                   //   Создаём объект для работы по протоколу Modbus указывая объект программной шины UART-RS485 и вывод DE конвертера UART-RS485.
iarduino_MB_pH sensor(modbus);                                                     //   Создаём объект для работы с pH-метром указывая объект протокола Modbus.
                                                                                   //
void setup(){                                                                      //
     Serial.begin(9600);   while(!Serial);                                         //   Инициируем передачу данных в монитор последовательного порта, указав его скорость.
     rs485.begin(9600); // while(!rs485 );                                         //   Инициируем работу с программной шиной UART-RS485 указав её скорость.
     modbus.begin();                                                               //   Инициируем работу по протоколу Modbus.
//   modbus.setTimeout(10);                                                        //   Указываем максимальное время ожидания ответа по протоколу Modbus.
//   modbus.setDelay(4);                                                           //   Указываем минимальный интервал между отправляемыми сообщениями по протоколу Modbus.
//   modbus.setTypeMB( MODBUS_RTU );                                               //   Указываем тип протокола Modbus: MODBUS_RTU (по умолчанию), или MODBUS_ASCII.
     sensor.begin(4);                                                              //   Инициируем работу с pH-метром, указав его адрес.
                                                                                   //   Если адрес не указан sensor.begin(), то он будет найден, но это займёт некоторое время.
//   Все указанные параметры будут сохранены в энергонезависимую память модуля:    //
     bool f[7];                                                                    //   Создаём массив из 7 флагов.
     f[0] = sensor.setKnownPH    ( 1,           4.00  );                           //   Кислотность жидкости     (0,000...14,000 pH) для 1 стадии калибровки модуля.                По умолчанию 04,00 pH.
     f[1] = sensor.setKnownPH    ( 2,           9.18  );                           //   Кислотность жидкости     (0,000...14,000 pH) для 2 стадии калибровки модуля.                По умолчанию 09,18 pH.
     f[2] = sensor.setVstp       (              30.00 );                           //   Смещение потенциала щупа (0,01 ...655,35 мВ) при изменении кислотности на 1 pH.             По умолчанию 30,00 мВ.
     f[3] = sensor.setPHn        (              7.000 );                           //   Нейтральная кислотность  (0,000...14,000 pH) при которой нет разности потенциалов.          По умолчанию 7,000 pH.
     f[4] = sensor.setFluctuation( STABLE_PH,   0.002 );                           //   Флуктуация кислотности   (0,001...14,000 pH) при которой показания считаются стабильными.   По умолчанию 0,002 pH.
     f[5] = sensor.setFluctuation( UNSTABLE_PH, 0.003 );                           //   Флуктуация кислотности   (0,001...14,000 pH) при которой показания считаются нестабильными. По умолчанию 0,003 pH.
     f[6] = f[0]&f[1]&f[2]&f[3]&f[4]&f[5];                                         //
                                                                                   //
//   Выводим результат записи настроек:                                            //
     if( f[6]==true  ){ Serial.println("Все настройки успешно записаны"        );} //
     if( f[0]==false ){ Serial.println("Не записана кислотность 1"             );} //
     if( f[1]==false ){ Serial.println("Не записана кислотность 2"             );} //
     if( f[2]==false ){ Serial.println("Не записан  шаг смещения напряжения"   );} //
     if( f[3]==false ){ Serial.println("Не записана нейтральная кислотность"   );} //
     if( f[4]==false ){ Serial.println("Не записана допустимая флуктуация"     );} //
     if( f[5]==false ){ Serial.println("Не записана максимальная флуктуация"   );} //
}                                                                                  //
                                                                                   //
void loop(){                                                                       //
}                                                                                  //