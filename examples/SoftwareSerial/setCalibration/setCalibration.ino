// ПРИМЕР КАЛИБРОВКИ МОДУЛЯ БЕЗ КНОПКИ:                                            //
                                                                                   //
#include <SoftwareSerial.h>                                                        //   Подключаем библиотеку для работы с программной шиной UART.
#include <iarduino_Modbus.h>                                                       //   Подключаем библиотеку для работы по протоколу Modbus.
#include <iarduino_MB_pH.h>                                                        //   Подключаем библиотеку для работы с pH-метрами.
                                                                                   //
SoftwareSerial rs485(8,9);                                                         //   Создаём объект для работы с программной шиной UART-RS485 указывая выводы RX, TX.
ModbusClient   modbus(rs485, 2);                                                   //   Создаём объект для работы по протоколу Modbus указывая объект программной шины UART-RS485 и вывод DE конвертера UART-RS485.
iarduino_MB_pH sensor(modbus);                                                     //   Создаём объект для работы с pH-метром указывая объект протокола Modbus.
                                                                                   //
void setup(){                                                                      //
     int8_t f;                                                                     //
     Serial.begin(9600); while(!Serial);                                           //   Инициируем передачу данных в монитор последовательного порта, указав его скорость.
     rs485.begin(9600); while(!rs485);                                             //   Инициируем работу с программной шиной UART-RS485 указав её скорость.
     modbus.begin();                                                               //   Инициируем работу по протоколу Modbus.
//   modbus.setTimeout(10);                                                        //   Указываем максимальное время ожидания ответа по протоколу Modbus.
//   modbus.setDelay(4);                                                           //   Указываем минимальный интервал между отправляемыми сообщениями по протоколу Modbus.
//   modbus.setTypeMB( MODBUS_RTU );                                               //   Указываем тип протокола Modbus: MODBUS_RTU (по умолчанию), или MODBUS_ASCII.
     f = sensor.begin(4);                                                          //   Инициируем работу с pH-метром, указав его адрес.
                                                                                   //   Если адрес не указан sensor.begin(), то он будет найден, но это займёт некоторое время.
//   Если любая из стадий калибровки длится дольше 2 минут:                        //
//   sensor.setFluctuation(STABLE_PH  , 0.005 );                                   //   Указываем предел допустимой флуктуации. Показания считаются стабильными если среднее значение кислотности за последние 10 секунд не сместилось за предел допустимой флуктуации.
//   sensor.setFluctuation(UNSTABLE_PH, 0.010 );                                   //   Указываем предел высокой флуктуации. Показания считаются не стабильными если среднее значение кислотности за последние 10 секунд сместилось за предел высокой флуктуации.
                                                                                   //   Сбросить значения в заводские поможет пример setSettings.
//   Выводим подсказки в монитор последовательного порта:                          //
     if( !f ){ Serial.println(F("Модуль не отвечает.")); return; }                 //
     Serial.println(F("Для калибровки потребуется две калибровочные жидкости:"));  //
     Serial.print  (F("- первая с кислотностью "));                                //
     Serial.print  (sensor.getKnownPH(1) );                                        //   Выводим кислотность первой калибровочной жидкости.
     Serial.println(F(" pH."));                                                    //
     Serial.print  (F("- вторая с кислотностью "));                                //
     Serial.print  (sensor.getKnownPH(2) );                                        //   Выводим кислотность второй калибровочной жидкости.
     Serial.println(F(" pH."));                                                    //
     Serial.println();                                                             //
     Serial.println(F("Опустите датчик в первую калибровочную жидкость и"));       //
     Serial.println(F("введите любой символ в монитор последовательного порта.")); //
     Serial.println();                                                             //
//   Ждём ввода любого символа в монитор последовательного порта:                  //
     while( !Serial.available() );                                                 //   Выполняем цикл пока не получим данные из монитора последовательного порта.
//   Начинаем калибровку:                                                          //
     f = sensor.setCalibration();                                                  //   Запускаем калибровку.
     if( f ){ Serial.println(F("Калибровка запущена."));         }                 //
     else   { Serial.println(F("Модуль не отвечает." )); return; }                 //
//   Сообщаем о выполнении 1 стадии калибровки:                                    //
     if( sensor.getCalibration()==1 ){                                             //
         Serial.println(F("Выполняется первая стадия калибровки..."));             //
         do{ f=sensor.getCalibration(); delay(100); }while( f==1 || f<0 );         //   Ждём завершения 1 стадии калибровки...
         Serial.println(F("Первая стадия калибровки завершена."));                 //
     }                                                                             //
//   Информируем о необходимости смены калибровочной жидкости:                     //
     if( sensor.getCalibration()==3 ){                                             //
         Serial.println();                                                         //
         Serial.println(F("Извлеките датчик из первой калибровочной жидкости."));  //
         Serial.println(F("Ополосните датчик в дистиллированной воде."));          //
         Serial.println(F("Опустите датчик во вторую калибровочную жидкость."));   //
         do{ f=sensor.getCalibration(); delay(100); }while( f==3 || f<0 );         //   Ждём когда модуль зафиксирует изменение кислотности...
     }                                                                             //
//   Сообщаем о выполнении 2 стадии калибровки:                                    //
     if( sensor.getCalibration()==2 ){                                             //
         Serial.println();                                                         //
         Serial.println(F("Выполняется вторая стадия калибровки..."));             //
         do{ f=sensor.getCalibration(); delay(100); }while( f==2 || f<0 );         //   Ждём завершения 2 стадии калибровки...
         Serial.println(F("Вторая стадия калибровки завершена."));                 //
     }                                                                             //
//   Сообщаем о ошибке калибровки:                                                 //
     if( sensor.getResultCalib()==false ){                                         //
         Serial.println();                                                         //
         Serial.println(F("Калибровка не выполнена. Данные не сохранены." ));      //
         Serial.println(F("Если любая из стадий калибровки длилась дольше 2мин,"));//
         Serial.println(F("то стоит увеличить диапазон флуктуаций."));             //
         Serial.println(F("См. комментарии скетча с функцией setFluctuation().")); //
         Serial.print  (F("Сейчас диапазон флуктуаций задан значениями: " ));      //   На 1 и 2 стадиях калибровки модуль ждёт стабилизации показаний кислотности.
         Serial.print  ( sensor.getFluctuation(STABLE_PH), 3 );                    //   Показания считаются стабильными если среднее значение кислотности за последние 10 секунд не сместилось за предел допустимой флуктуации.
         Serial.print  (F(" ... "));                                               //   Если показания стали нестабильными, модуль заново начнёт ждать их стабилизации.
         Serial.print  ( sensor.getFluctuation(UNSTABLE_PH), 3 );                  //   Показания считаются не стабильными если среднее значение кислотности за последние 10 секунд сместилось за предел высокой флуктуации.
         Serial.println(F(" pH."));                                                //
         return;                                                                   //
     }                                                                             //
//   Сообщаем о успехе калибровки и выводим данные полученные в её процессе:       //
     Serial.println();                                                             //
     Serial.println(F("Калибровка успешно завершена. Данные сохранены." ));        //
     Serial.println(F("Результат калибровки:"));                                   //
     Serial.println(F("Изменение кислотности на 1pH приводит к изменению"));       //
     Serial.print  (F("потенциала датчика (щупа) на "));                           //
     Serial.print  ( sensor.getVstp() );                                           //   Выводим Vstp - шаг смещения напряжения датчика.
     Serial.println(F(" мВ. (эталонное значение 30.00 мВ)"));                      //
     Serial.println(F("Разница потенциалов на выводах датчика (щупа) равна 0"));   //
     Serial.print  (F("при кислотности жидкости "));                               //
     Serial.print  ( sensor.getPHn() );                                            //   Выводим PHn - нейтральную кислотность для датчика.
     Serial.println(F(" pH. (эталонное значение 7.00 pH)"));                       //
     Serial.println(F("Новые значения сохранены в энергонезависимую память."));    //
}                                                                                  //
                                                                                   //
void loop(){                                                                       //
}                                                                                  //