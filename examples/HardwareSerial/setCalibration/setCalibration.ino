// ПРИМЕР КАЛИБРОВКИ МОДУЛЯ БЕЗ КНОПКИ:                                            //
                                                                                   //
#include <iarduino_Modbus.h>                                                       //   Подключаем библиотеку для работы по протоколу Modbus.
#include <iarduino_MB_pH.h>                                                        //   Подключаем библиотеку для работы с pH-метрами.
                                                                                   //
ModbusClient   modbus(Serial1, 2);                                                 //   Создаём объект для работы по протоколу Modbus указывая объект шины UART-RS485 и вывод DE конвертера UART-RS485.
iarduino_MB_pH sensor(modbus);                                                     //   Создаём объект для работы с pH-метром указывая объект протокола Modbus.
                                                                                   //
void setup(){                                                                      //
     int8_t f;                                                                     //
     Serial.begin(9600); while(!Serial);                                           //   Инициируем передачу данных в монитор последовательного порта, указав его скорость.
     Serial1.begin(9600); while(!Serial1);                                         //   Инициируем работу с шиной UART-RS485 указав её скорость.
     modbus.begin();                                                               //   Инициируем работу по протоколу Modbus.
//   modbus.setTimeout(10);                                                        //   Указываем максимальное время ожидания ответа по протоколу Modbus.
//   modbus.setDelay(4);                                                           //   Указываем минимальный интервал между отправляемыми сообщениями по протоколу Modbus.
//   modbus.setTypeMB( MODBUS_RTU );                                               //   Указываем тип протокола Modbus: MODBUS_RTU (по умолчанию), или MODBUS_ASCII.
     f = sensor.begin(4);                                                          //   Инициируем работу с pH-метром, указав его адрес.
                                                                                   //   Если адрес не указан sensor.begin(), то он будет найден, но это займёт некоторое время.
//   Выводим подсказки в монитор последовательного порта:                          //
     if( !f ){ Serial.println(F("Модуль не отвечает.")); return; }                 //
     Serial.println(F("Для калибровки потребуется две калибровочные жидкости:"));  //
     Serial.print  (F("- первая с кислотностью "));                                //
     Serial.print  (sensor.getKnownPH(1) );                                        //   Выводим кислотность первой калибровочной жидкости.
     Serial.println(F(" pH."));                                                    //
     Serial.print  (F("- вторая с кислотностью "));                                //
     Serial.print  (sensor.getKnownPH(2) );                                        //   Выводим кислотность второй калибровочной жидкости.
     Serial.println(F(" pH."));                                                    //
     Serial.println();                                                             //
     Serial.println(F("Опустите датчик в первую калибровочную жидкость и"));       //
     Serial.println(F("введите любой символ в монитор последовательного порта.")); //
     Serial.println();                                                             //
//   Ждём ввода любого символа в монитор последовательного порта:                  //
     while( !Serial.available() );                                                 //   Выполняем цикл пока не получим данные из монитора последовательного порта.
//   Начинаем калибровку:                                                          //
     f = sensor.setCalibration();                                                  //   Запускаем калибровку.
     if( f ){ Serial.println(F("Калибровка запущена."));         }                 //
     else   { Serial.println(F("Модуль не отвечает." )); return; }                 //
//   Сообщаем о выполнении 1 стадии калибровки:                                    //
     if( sensor.getCalibration()==1 ){                                             //
         Serial.println(F("Выполняется первая стадия калибровки..."));             //
		 do{ f=sensor.getCalibration(); delay(100); }while( f==1 || f<0 );         //   Ждём завершения 1 стадии калибровки...
         Serial.println(F("Первая стадия калибровки завершена."));                 //
     }                                                                             //
//   Информируем о необходимости смены калибровочной жидкости:                     //
     if( sensor.getCalibration()==3 ){                                             //
         Serial.println();                                                         //
         Serial.println(F("Извлеките датчик из первой калибровочной жидкости."));  //
         Serial.println(F("Ополосните датчик в дистиллированной воде."));          //
         Serial.println(F("Опустите датчик во вторую калибровочную жидкость."));   //
		 do{ f=sensor.getCalibration(); delay(100); }while( f==3 || f<0 );         //   Ждём когда модуль зафиксирует изменение кислотности...
     }                                                                             //
//   Сообщаем о выполнении 2 стадии калибровки:                                    //
     if( sensor.getCalibration()==2 ){                                             //
         Serial.println();                                                         //
         Serial.println(F("Выполняется вторая стадия калибровки..."));             //
		 do{ f=sensor.getCalibration(); delay(100); }while( f==2 || f<0 );         //   Ждём завершения 2 стадии калибровки...
         Serial.println(F("Вторая стадия калибровки завершена."));                 //
     }                                                                             //
//   Сообщаем о результате калибровки:                                             //
     Serial.println();                                                             //
     Serial.println(F("Калибровка "));                                             //
     if( sensor.getResultCalib()==1 ){ Serial.println(F("выполнена успешно.")); }  //
     else{ Serial.println(F("не выполнена." )); return; }                          //
//   Выводим данные полученные в процессе калибровки:                              //
     Serial.println();                                                             //
     Serial.println(F("Результат калибровки:"));                                   //
     Serial.println(F("Изменение кислотности на 1pH приводит к изменению"));       //
     Serial.print  (F("потенциала датчика (щупа) на "));                           //
     Serial.print  ( sensor.getVstp() );                                           //   Выводим Vstp - шаг смещения напряжения датчика.
     Serial.println(F(" мВ. (эталонное значение 59.16 мВ)"));                      //
     Serial.println(F("Разница потенциалов на выводах датчика (щупа) равна 0"));   //
     Serial.print  (F("при кислотности жидкости "));                               //
     Serial.print  ( sensor.getPHn() );                                            //   Выводим PHn - нейтральную кислотность для датчика.
     Serial.println(F(" pH. (эталонное значение 7.00 pH)"));                       //
     Serial.println(F("Новые значения сохранены в энергонезависимую память."));    //
}                                                                                  //
                                                                                   //
void loop(){                                                                       //
}                                                                                  //
